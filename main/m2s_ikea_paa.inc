// IKEA production PAA from CSA DCL; SHA256:
// c082419ec362c074046763e4eda04fdaacb4439380b8976d2f561a6b7f83eba1
#if CONFIG_CUSTOM_ATTESTATION_TRUST_STORE
#include <esp_matter_attestation_trust_store.h>
#include <lib/support/Span.h>

namespace {
static const uint8_t kM2sIkeaPaa[] = {
    0x30, 0x82, 0x01, 0xe3, 0x30, 0x82, 0x01, 0x8a, 0xa0, 0x03, 0x02, 0x01,
    0x02, 0x02, 0x14, 0x3e, 0xa1, 0x21, 0x71, 0xfa, 0x06, 0xc1, 0x6f, 0xf2,
    0xb7, 0xfa, 0x91, 0xb0, 0x1b, 0x3e, 0x8d, 0xfe, 0xcc, 0x92, 0x5b, 0x30,
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    0xac, 0x97, 0x54, 0xac, 0x93, 0x8f, 0xfe,
};
static const uint8_t kM2sIkeaSkid[] = {
    0x6b, 0x31, 0x8c, 0xfc, 0xe9, 0x99, 0x20, 0xd7, 0x32, 0x8f, 0x5f, 0x43,
    0x6d, 0x5e, 0xa3, 0x32, 0xb8, 0xb7, 0x5d, 0x9a,
};

class M2sIkeaTrustStore final : public chip::Credentials::AttestationTrustStore {
public:
    CHIP_ERROR GetProductAttestationAuthorityCert(
        const chip::ByteSpan &skid,
        chip::MutableByteSpan &output) const override
    {
        if (!skid.data_equal(chip::ByteSpan(kM2sIkeaSkid, sizeof(kM2sIkeaSkid)))) {
            return CHIP_ERROR_CA_CERT_NOT_FOUND;
        }
        return chip::CopySpanToMutableSpan(
            chip::ByteSpan(kM2sIkeaPaa, sizeof(kM2sIkeaPaa)), output);
    }
};

void m2s_install_ikea_paa()
{
    static M2sIkeaTrustStore store;
    chip::Credentials::set_custom_attestation_trust_store(&store);
    ESP_LOGI("M2S_PAA", "IKEA production PAA installed; VID=0x117C");
}
} // namespace
#endif
