## main/Kconfig.projbuild
```kconfig
menu "OpenThread Border Router Example"

    config OPENTHREAD_SUPPORT_HW_RESET_RCP
        bool 'Enable hardware RCP resetting'
        default n
        help
            If enabled, the Thread Border Router will support hardware resetting the RCP
            when processing RCP failure.

    config OPENTHREAD_HW_RESET_RCP_PIN
        int 'Pin to RCP reset'
        depends on OPENTHREAD_SUPPORT_HW_RESET_RCP
        default 7

endmenu

menu "Matter2Supla"

    config M2S_MATTER_CONTROLLER_AUTOSTART
        bool "EXPERIMENTAL: start Matter Controller (NVS/Wi-Fi risk)"
        depends on ESP_MATTER_CONTROLLER_ENABLE && ESP_MATTER_COMMISSIONER_ENABLE
        default n
        help
            Keep disabled until NVS backup and Wi-Fi coexistence are verified.

    config M2S_MATTER_CONTROLLER_MANUAL_CLI
        bool "EXPERIMENTAL: manual Matter Controller CLI start"
        depends on ESP_MATTER_CONTROLLER_ENABLE && ESP_MATTER_COMMISSIONER_ENABLE && OPENTHREAD_CLI
        default n
        help
            Register a serial CLI command. Starting Matter may write CHIP data to NVS.

endmenu
```

## sdkconfig.defaults
```kconfig
#
# Partition Table
#
CONFIG_PARTITION_TABLE_CUSTOM=y
CONFIG_PARTITION_TABLE_CUSTOM_FILENAME="partitions_32mb.csv"
CONFIG_PARTITION_TABLE_FILENAME="partitions_32mb.csv"
CONFIG_PARTITION_TABLE_MD5=y
# end of Partition Table

#
# mbedTLS
#
CONFIG_MBEDTLS_CMAC_C=y
CONFIG_MBEDTLS_SSL_PROTO_DTLS=y
CONFIG_MBEDTLS_KEY_EXCHANGE_ECJPAKE=y
# end of TLS Key Exchange Methods

CONFIG_MBEDTLS_ECJPAKE_C=y
# end of mbedTLS

#
# OpenThread
#
CONFIG_OPENTHREAD_ENABLED=y
CONFIG_OPENTHREAD_BORDER_ROUTER=y
CONFIG_OPENTHREAD_RADIO_NATIVE=y
CONFIG_OPENTHREAD_TASK_SIZE=8192
CONFIG_OPENTHREAD_CONSOLE_ENABLE=n
# end of OpenThread

#
# lwIP
#
CONFIG_LWIP_IPV6_FORWARD=y
CONFIG_LWIP_IPV6_NUM_ADDRESSES=12
CONFIG_LWIP_MULTICAST_PING=y
CONFIG_LWIP_NETIF_STATUS_CALLBACK=y
CONFIG_LWIP_HOOK_IP6_ROUTE_DEFAULT=y
CONFIG_LWIP_HOOK_ND6_GET_GW_DEFAULT=y
CONFIG_LWIP_HOOK_IP6_INPUT_CUSTOM=y
CONFIG_LWIP_HOOK_IP6_SELECT_SRC_ADDR_CUSTOM=y
CONFIG_LWIP_IPV6_AUTOCONFIG=y
# end of lwIP

#
# mDNS
#
CONFIG_MDNS_MULTIPLE_INSTANCE=y
# end of mDNS

# Example connect
CONFIG_EXAMPLE_CONNECT_THREAD=n

#
# ESP System Settings
#
CONFIG_ESP_SYSTEM_EVENT_TASK_STACK_SIZE=3584
CONFIG_ESP_MAIN_TASK_STACK_SIZE=6144
# end of ESP System Settings

#
# Serial flasher config
#
CONFIG_ESPTOOLPY_FLASHSIZE_32MB=y

# Matter2Supla v0.9: JEDEN ESP32-C5 32MB + 8MB PSRAM.
CONFIG_ESP_COEX_SW_COEXIST_ENABLE=y
CONFIG_EXAMPLE_CONNECT_WIFI=y
CONFIG_OPENTHREAD_NETWORK_AUTO_START=y
CONFIG_OPENTHREAD_CLI=y
CONFIG_OPENTHREAD_CLI_ESP_EXTENSION=y
CONFIG_FREERTOS_HZ=1000
CONFIG_AUTOSTART_ARDUINO=n
CONFIG_SPIRAM=y
CONFIG_SPIRAM_MODE_QUAD=y
CONFIG_SPIRAM_SPEED_80M=y
CONFIG_SPIRAM_USE_MALLOC=y
```
